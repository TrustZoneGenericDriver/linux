## drivers/sec-hw/Kconfig
```kconfig
#
# Copyright (c) 2015, Linaro Limited
#
# This program is free software; you can redistribute it and/or modify
# it under the terms of the GNU General Public License Version 2 as
# published by the Free Software Foundation.
#
# This program is distributed in the hope that it will be useful,
# but WITHOUT ANY WARRANTY; without even the implied warranty of
# MERCHANTABILITY or FITNESS FOR A PARTICULAR PURPOSE. See the
# GNU General Public License for more details.
#
# You should have received a copy of the GNU General Public License along
# with this program.  If not, see <http://www.gnu.org/licenses/>

# Generic Trusted Execution Environment Configuration
config TEE_GENERIC
	bool "Trusted Execution Environment support"
	default n
	select DMA_SHARED_BUFFER
	help
	  This implements a generic interface towards a Trusted Execution
	  Environment (TEE).

if TEE_GENERIC

menu "TEE drivers"

endmenu

endif
```

## drivers/sec-hw/optee/Kconfig
```kconfig
#
# Copyright (c) 2015, Linaro Limited
#
# This program is free software; you can redistribute it and/or modify
# it under the terms of the GNU General Public License Version 2 as
# published by the Free Software Foundation.
#
# This program is distributed in the hope that it will be useful,
# but WITHOUT ANY WARRANTY; without even the implied warranty of
# MERCHANTABILITY or FITNESS FOR A PARTICULAR PURPOSE. See the
# GNU General Public License for more details.
#
# You should have received a copy of the GNU General Public License along
# with this program.  If not, see <http://www.gnu.org/licenses/>

# OP-TEE Trusted Execution Environment Configuration
config TEE_OPTEE
	tristate "OP-TEE"
	default n
	depends on TEE_GENERIC
	help
	  This implements the OP-TEE Trusted Execution Environment (TEE) driver.
```

## drivers/sechw/Kconfig
```kconfig
#
# Secure hardware configuration
#

menu "Secure Hardware Devices"

#TrustZone
source "drivers/sechw/trustzone/Kconfig"

endmenu
```

## drivers/sechw/trustzone/Kconfig
```kconfig
#
# Copyright (C) 2014 Javier González
#
# TrustZone device configuration
#

menuconfig SECURE_HARDWARE
	tristate "Secure Hardware Support"
	select SECURITYFS
	---help---
	If you have a piece of secure hardware that you want to configure say Yes.
	To compile this driver as a module choose M here. If unsure say N.

if SECURE_HARDWARE

config ARM_TRUSTZONE
	tristate "TrustZone Support"
	depends on ARM
	---help---
	If you have an ARM processor that is compatible with TrustZone and were
	the TrustZone security extensions are anabled say Yes to get support
	from within the Linux kernel. If unsure, say N.
	# TODO: We need to specify what are the dependencies.

config TRUSTZONE_SIERRAWARE
	tristate "Sierraware TrustZone driver"
	depends on ARM_TRUSTZONE
	---help---
	If you use Sierraware's SierraTEE or OpenVirtualization say Yes to get
	support from within the Linux Kernel. If unsure, say N.

endif # SECURE_HARDWARE
```
